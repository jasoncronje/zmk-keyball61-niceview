## modules/Kconfig
```kconfig
rsource "touchid-power/Kconfig"
rsource "status-screen/Kconfig"
rsource "keylog/Kconfig"
rsource "pmw3610/Kconfig"
```

## modules/dts/bindings/input_processors/zmk,input-processor-pointer-accel.yaml
```yaml
description: |
  Speed-dependent pointer gain. Slow steps get low-factor, fast steps
  high-factor, with a smooth ramp between speed-low and speed-high. Speed is
  measured on the raw sensor counts, before any gain. Meant to run with the
  host's own acceleration turned off.

compatible: "zmk,input-processor-pointer-accel"

include: ip_common.yaml

properties:
  "#input-processor-cells":
    type: int
    required: true
    const: 0
  low-factor:
    type: int
    required: true
    description: gain at and below speed-low, in thousandths (1000 = 1.0x)
  high-factor:
    type: int
    required: true
    description: gain at and above speed-high, in thousandths
  speed-low:
    type: int
    required: true
    description: sensor counts per second where the ramp starts
  speed-high:
    type: int
    required: true
    description: sensor counts per second where the ramp ends
  smoothing:
    type: int
    default: 400
    description: weight of the newest step in the speed average, out of 1000 (1000 = none)
  sample-period-us:
    type: int
    default: 4000
    description: |
      Sensor sample period in microseconds (4000 for a PMW3610 at 250 Hz).
      Readings less than three periods apart are timed as one period each,
      because they reach the processor in uneven clumps and their arrival
      times would make the gain jump between readings.
```

## modules/dts/bindings/input_processors/zmk,input-processor-transport-scaler.yaml
```yaml
description: |
  Scales pointer movement by a different fraction on USB and on BLE, so the
  pointer can feel the same on both. BLE reports carry several sensor readings
  merged into one, and macOS accelerates those bigger steps more.

compatible: "zmk,input-processor-transport-scaler"

include: ip_common.yaml

properties:
  "#input-processor-cells":
    type: int
    required: true
    const: 0
  type:
    type: int
    default: 0x02 # INPUT_EV_REL
  codes:
    type: array
    required: true
  usb-scale:
    type: array
    required: true
    description: <multiplier divisor> used while USB is the selected output
  ble-scale:
    type: array
    required: true
    description: <multiplier divisor> used while BLE is the selected output
```
